## Kconfig
```kconfig
config BT60_POWER_CONFIRM
    bool "Require Fn + the Soft Off key held to turn on after a key soft-off"
    default y
    depends on ZMK_PM_SOFT_OFF && SOC_SERIES_NRF52X

if BT60_POWER_CONFIRM

config BT60_POWER_CONFIRM_FN_POSITION
    int "Key position of the Fn key"
    default 60

config BT60_POWER_CONFIRM_FALLBACK_POSITION
    int "Key used with Fn to turn on when the keymap has no Soft Off key (Left Ctrl)"
    default 53

config BT60_POWER_CONFIRM_HOLD_MS
    int "How long Fn + the Soft Off key must be held to turn on"
    default 3000

config BT60_POWER_CONFIRM_TIMEOUT_MS
    int "Go back to soft-off if not confirmed within this time"
    default 8000

endif
```

## boards/ryong/ryong60/Kconfig
```kconfig
# Copyright (c) 2021 Nick Winans
# SPDX-License-Identifier: MIT

config BOARD_ENABLE_DCDC
    bool "Enable DCDC mode"
    select SOC_DCDC_NRF52X
    default y
    depends on BOARD_RYONG60

config RYONG_WAKE_POSITION
    int "Key position of the wake key (set on key.ryong.com; must match ryong-wake.dtsi)"
    default 60
    depends on BOARD_RYONG60
```

## boards/ryong/ryong60/Kconfig.defconfig
```kconfig
# Copyright (c) 2021 Nick Winans
# SPDX-License-Identifier: MIT

if BOARD_RYONG60

config ZMK_KEYBOARD_NAME
    default "ryong60"

if USB_DEVICE_STACK

config USB_NRFX
    default y

endif # USB_DEVICE_STACK

config BT_CTLR
    default BT

endif # BOARD_RYONG60
```

## boards/ryong/ryong60/Kconfig.ryong60
```kconfig
# Copyright (c) 2021 Nick Winans
# SPDX-License-Identifier: MIT

config BOARD_RYONG60
    select SOC_NRF52840_QIAA
    select ZMK_BOARD_COMPAT if BOARD_RYONG60_NRF52840_ZMK
    imply RETAINED_MEM if BOARD_RYONG60_NRF52840_ZMK
    imply RETENTION if BOARD_RYONG60_NRF52840_ZMK
    imply RETENTION_BOOT_MODE if BOARD_RYONG60_NRF52840_ZMK
```

## boards/ryong/ryong60/board.yml
```yaml
board:
  name: ryong60
  socs:
    - name: nrf52840
      variants:
        - name: zmk
```
