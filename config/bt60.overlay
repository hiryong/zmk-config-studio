/*
 * Soft-off wake key. The devicetree for it is generated by key.ryong.com from ryong-power.json
 * (Firmware → edit → Wake key): only that key wakes the keyboard after a Soft Off, and
 * src/bt60_power_confirm.c then asks for it together with a Soft Off key, held 3 s.
 * The matrix keeps its normal wakeup-source so 15 min idle sleep still wakes on any key;
 * ZMK turns that off by itself when entering soft-off.
 */

#include "ryong-wake.dtsi"
